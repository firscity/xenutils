## CMakeLists.txt
```
# SPDX-License-Identifier: Apache-2.0

cmake_minimum_required(VERSION 3.13.1)
include($ENV{ZEPHYR_BASE}/cmake/app/boilerplate.cmake NO_POLICY_SCOPE)

set(UTILS_SCRIPTS_DIR ${CMAKE_CURRENT_SOURCE_DIR}/scripts)
if (DTC)
    add_custom_target(
        fix_dtb
        DEPENDS ${ZEPHYR_FINAL_EXECUTABLE}
        COMMAND ${UTILS_SCRIPTS_DIR}/fix_dtb.sh ${UTILS_SCRIPTS_DIR}/gicv2.tmpl ${ZEPHYR_BINARY_DIR}/virt_gicv2.dtb ${ZEPHYR_BINARY_DIR}/zephyr.bin)
else()
    message(WARNING "No dtc progren")
endif()

project(xenutils)

include_directories(app PRIVATE ${CMAKE_CURRENT_SOURCE_DIR}/include)
target_sources_ifdef(CONFIG_XEN_INITIAL_DOMAIN app PRIVATE src/xen_cmds.c src/dom0.c src/console_util.c src/xen_bus.c src/uboot_domu.S)

include(ExternalProject)
set(XEN_SRCDIR ${CMAKE_CURRENT_SOURCE_DIR}/../xen)
set(XEN_BINDIR ${CMAKE_CURRENT_BINARY_DIR}/hyp)

ExternalProject_Add(
   hypervisor
   PREFIX ${XEN_BINDIR}
   SOURCE_DIR ${XEN_SRCDIR}/xen
   BINARY_DIR ${XEN_BINDIR}
   CONFIGURE_COMMAND ""
   BUILD_COMMAND ${MAKE} make -C ${XEN_SRCDIR}/xen O=${XEN_BINDIR}
      CONFIG_QEMU_XEN=y CONFIG_DEBUG=y XSM_ENABLE=y
      XEN_TARGET_ARCH=arm64 CROSS_COMPILE=aarch64-linux-gnu- HOSTCC=gcc
  INSTALL_COMMAND cp ${XEN_BINDIR}/xen ${ZEPHYR_BINARY_DIR}/xen
)

add_dependencies(app hypervisor)
```

## west.yml
```
# SPDX-License-Identifier: Apache-2.0
# West yml manifest for Zephyr as Xen dom0

manifest:
  self:
    path: xenutils

  remotes:
    - name: sakib
      url-base: https://github.com/sa-kib/
    - name: firscity
      url-base: https://github.com/firscity/
    - name: dsemenets
      url-base: https://github.com/dsemenets/
    - name: zephyr
      url-base: https://github.com/zephyrproject-rtos
    - name: xentroops
      url-base: https://github.com/xen-troops/

  projects:
    - name: zephyr
      remote: firscity
      revision: zephyr_aos_porting
      west-commands: scripts/west-commands.yml
    - name: xen
      remote: xentroops
      revision: xen-4.17rc-migration
    - name: littlefs
      remote: zephyr
      path: modules/fs/littlefs
      groups:
        - fs
      revision: ca583fd297ceb48bced3c2548600dc615d67af24
```

## prj.conf
```kconfig
CONFIG_MP_NUM_CPUS=1
```

## include/domain.h
```c
#ifndef XENUTILS_DOMAIN_H
#define XENUTILS_DOMAIN_H

#include <zephyr/xen/events.h>
#include <zephyr/xen/generic.h>

struct xen_domain_iomem {
	/* where to map, if 0 - map to same place as mfn */
	uint64_t first_gfn;
	/* what to map */
	uint64_t first_mfn;
	/* how much frames to map */
	uint64_t nr_mfns;
};

struct xen_domain_cfg {
	uint64_t mem_kb;

	uint32_t flags;
	uint32_t max_vcpus;
	uint32_t max_evtchns;
	int32_t gnt_frames;
	int32_t max_maptrack_frames;

	/* ARM arch related */
	uint8_t gic_version;
	uint16_t tee_type;

	/* For peripheral sharing*/
	struct xen_domain_iomem *iomems;
	uint32_t nr_iomems;

	uint32_t *irqs;
	uint32_t nr_irqs;

	char **dtdevs;
	uint32_t nr_dtdevs;
};

struct xen_domain {
	uint32_t domid;
	struct xencons_interface *intf;
	struct xenstore_domain_interface *domint;
	int num_vcpus;
	int address_size;
	uint64_t max_mem_kb;
	sys_dnode_t node;
	size_t stack_slot;

	struct k_sem console_sem;
	struct k_thread console_thrd;
	k_tid_t console_tid;
	bool console_thrd_stop;
	evtchn_port_t console_evtchn;
	evtchn_port_t local_console_evtchn;

	struct k_sem xb_sem;
	struct k_thread xenstore_thrd;
	bool xenstore_thrd_stop;
	k_tid_t xenstore_tid;
	evtchn_port_t xenstore_evtchn;
	evtchn_port_t local_xenstore_evtchn;

	int transaction;
	int running_transaction;
	int stop_transaction_id;
	bool pending_stop_transaction;
};

#endif /* XENUTILS_DOMAIN_H */
```

## include/message_handlers.h
```c
#ifndef XENBUS_MESSAGE_HANDLERS_H
#define XENBUS_MESSAGE_HANDLERS_H

void handle_control(struct xen_domain *domain, uint32_t id, char *payload, uint32_t len);
void handle_get_perms(struct xen_domain *domain, uint32_t id, char *payload, uint32_t len);
void handle_set_perms(struct xen_domain *domain, uint32_t id, char *payload, uint32_t len);
void handle_reset_watches(struct xen_domain *domain, uint32_t id, char *payload, uint32_t len);
void handle_directory(struct xen_domain *domain, uint32_t id, char *payload, uint32_t len);
void handle_read(struct xen_domain *domain, uint32_t id, char *payload, uint32_t len);
void handle_write(struct xen_domain *domain, uint32_t id, char *payload, uint32_t len);
void handle_mkdir(struct xen_domain *domain, uint32_t id, char *payload, uint32_t len);
void handle_rm(struct xen_domain *domain, uint32_t id, char *payload, uint32_t len);
void handle_watch(struct xen_domain *domain, uint32_t id, char *payload, uint32_t len);
void handle_unwatch(struct xen_domain *domain, uint32_t id, char *payload, uint32_t len);
void handle_transaction_start(struct xen_domain *domain, uint32_t id, char *payload, uint32_t len);
void handle_transaction_stop(struct xen_domain *domain, uint32_t id, char *payload, uint32_t len);
void handle_get_domain_path(struct xen_domain *domain, uint32_t id, char *payload, uint32_t len);

#endif
```

## include/processing.h
```c
#ifndef XENBUS_PROCESSING_H
#define XENBUS_PROCESSING_H

void xenbus_evt_thrd(void *p1, void *p2, void *p3);
int start_domain_stored(struct xen_domain *domain);
int stop_domain_stored(struct xen_domain *domain);

#define DOM_MAX 4

#endif
```

## include/xss_processing.h
```c
#ifndef XENBUS_PROCESSING_H
#define XENBUS_PROCESSING_H

void xenstore_evt_thrd(void *p1, void *p2, void *p3);
int start_domain_stored(struct xen_domain *domain);
int stop_domain_stored(struct xen_domain *domain);

#define DOM_MAX 4
#define STRING_LENGTH_MAX 128

#endif
```

## include/xss_storage.h
```c
#ifndef XENBUS_STORAGE_H
#define XENBUS_STORAGE_H

struct xs_entry {
	char *key;
	char *value;
	sys_dlist_t child_list;

	sys_dnode_t node;
};

struct watch_entry {
	char *key;
	char *token;
	int domid;
	bool is_relative;

	sys_dnode_t node;
};

struct pending_watch_event_entry {
	char *key;
	int domid;

	sys_dnode_t node;
};

#endif
```

## src/console_util.c
```c
#include <zephyr/xen/generic.h>
#include <zephyr/xen/public/io/console.h>
#include <zephyr/xen/public/memory.h>
#include <zephyr/xen/public/xen.h>
#include <zephyr/xen/hvm.h>

#include <zephyr/init.h>
#include <zephyr/kernel.h>
#include <string.h>
#include <stdio.h>

#include "domain.h"
#include "xss_processing.h"

#define XSS_CONSOLE_STACK_SIZE_PER_DOM 8192
K_KERNEL_STACK_DEFINE(read_thrd_stack, XSS_CONSOLE_STACK_SIZE_PER_DOM * DOM_MAX);
static size_t stack_slots[DOM_MAX] = { 0 };

/*
 * Need to read from OUT ring in dom0, domU writes logs there
 * TODO: place this in separate driver
 */
static int read_from_ring(struct xencons_interface *intf, char *str, int len)
{
	int recv = 0;
	XENCONS_RING_IDX cons = intf->out_cons;
	XENCONS_RING_IDX prod = intf->out_prod;
	XENCONS_RING_IDX out_idx = 0;

	compiler_barrier();
	__ASSERT((prod - cons) <= sizeof(intf->out), "Invalid input ring buffer");

	while (cons != prod && recv < len) {
		out_idx = MASK_XENCONS_IDX(cons, intf->out);
		str[recv] = intf->out[out_idx];
		recv++;
		cons++;
	}

	compiler_barrier();
	intf->out_cons = cons;

	return recv;
}

void console_read_thrd(void *dom, void *p2, void *p3)
{
	ARG_UNUSED(p2);
	ARG_UNUSED(p3);
	char buffer[128];
	char out[128];
	const int buflen = 128;
	int recv;
	int nlpos = 0;
	struct xen_domain *domain = (struct xen_domain *)dom;

	compiler_barrier();
	while (!domain->console_thrd_stop) {
		k_sem_take(&domain->console_sem, K_FOREVER);

		do {
			memset(out, 0, buflen);
			memset(buffer, 0, buflen);
			recv = read_from_ring(domain->intf, buffer + nlpos,
					      sizeof(buffer) - nlpos - 1);
			if (recv) {
				memcpy(out, buffer, recv);
					printk("%s", buffer);
			}
		} while (recv);
	}
}

void evtchn_callback(void *priv)
{
	struct xen_domain *domain = (struct xen_domain *)priv;
	k_sem_give(&domain->console_sem);
}

int init_domain_console(struct xen_domain *domain)
{
	int rc = 0;

	rc = bind_interdomain_event_channel(domain->domid, domain->console_evtchn,
					       evtchn_callback, domain);

	if (rc < 0)
		return rc;

	domain->local_console_evtchn = rc;

	k_sem_init(&domain->console_sem, 1, 1);

	printk("%s: bind evtchn %d as %d\n", __func__, domain->console_evtchn,
	       domain->local_console_evtchn);

	rc = hvm_set_parameter(HVM_PARAM_CONSOLE_EVTCHN, domain->domid, domain->console_evtchn);

	if (rc) {
		printk("Failed to set domain console evtchn param, rc= %d\n", rc);
		return rc;
	}

	return rc;
}

int start_domain_console(struct xen_domain *domain)
{
	size_t slot = 0;

	if (domain->console_tid) {
		printk("Console thread is already running for this domain!\n");
		return -EBUSY;
	}

	for (; slot < DOM_MAX && stack_slots[slot] != 0; ++slot);

	if (slot >= DOM_MAX) {
		printk("Unable to find memory for console stack (%ld >= MAX:%d)\n", slot, DOM_MAX);
		return 1;
	}

	stack_slots[slot] = domain->domid;
	k_sem_init(&domain->console_sem, 1, 1);
	domain->console_thrd_stop = false;
	domain->console_tid =
		k_thread_create(&domain->console_thrd, read_thrd_stack + XSS_CONSOLE_STACK_SIZE_PER_DOM * slot,
				K_KERNEL_STACK_SIZEOF(read_thrd_stack) / DOM_MAX, console_read_thrd, domain,
				NULL, NULL, 7, 0, K_NO_WAIT);

	return 0;
}

int stop_domain_console(struct xen_domain *domain)
{
	int rc;
	size_t slot = 0;

	if (!domain->console_tid) {
		printk("No console thread is running!\n");
		return -ESRCH;
	}

	domain->console_thrd_stop = true;
	/* Send event to end read cycle */
	k_sem_give(&domain->console_sem);
	k_thread_join(&domain->console_thrd, K_FOREVER);
	domain->console_tid = NULL;

	for (; slot < DOM_MAX && stack_slots[slot] != domain->domid; ++slot);

	if (slot < DOM_MAX) {
		stack_slots[slot] = 0;
	}

	unbind_event_channel(domain->local_console_evtchn);
	rc = evtchn_close(domain->local_console_evtchn);

	if (rc)
	{
		printk("Unable to close event channel: %d\n", domain->local_console_evtchn);
		return rc;
	}

	return 0;
}
```

## src/xen_bus.c
```c
#include <stdint.h>
#include <string.h>
#include <stdio.h>

#include <zephyr/xen/events.h>
#include <zephyr/xen/public/hvm/params.h>
#include <zephyr/xen/public/io/xs_wire.h>
#include <zephyr/xen/hvm.h>

#include "domain.h"
#include "xss_storage.h"
#include "xss_message_handlers.h"
#include "xss_processing.h"

#define XENSTORE_STACK_SIZE_PER_DOM (32 * 1024)
K_KERNEL_STACK_DEFINE(xenstore_thrd_stack, XENSTORE_STACK_SIZE_PER_DOM *DOM_MAX);
static int stack_slots[DOM_MAX] = { 0 };

K_MUTEX_DEFINE(xsel_mutex);
K_MUTEX_DEFINE(pfl_mutex);
K_MUTEX_DEFINE(wel_mutex);

sys_dlist_t watch_entry_list = SYS_DLIST_STATIC_INIT(&watch_entry_list);
sys_dlist_t pending_watch_event_list = SYS_DLIST_STATIC_INIT(&pending_watch_event_list);

struct xs_entry root_xenstore;

struct message_handle {
	void (*h)(struct xen_domain *domain, uint32_t id, char *payload, uint32_t sz);
};

const struct message_handle message_handle_list[XS_TYPE_COUNT] = { [XS_CONTROL] = { handle_control },
					    [XS_DIRECTORY] = { handle_directory },
					    [XS_READ] = { handle_read },
					    [XS_GET_PERMS] = { handle_get_perms },
					    [XS_WATCH] = { handle_watch },
					    [XS_UNWATCH] = { handle_unwatch },
					    [XS_TRANSACTION_START] = { handle_transaction_start },
					    [XS_TRANSACTION_END] = { handle_transaction_stop },
					    [XS_INTRODUCE] = { NULL },
					    [XS_RELEASE] = { NULL },
					    [XS_GET_DOMAIN_PATH] = { handle_get_domain_path },
					    [XS_WRITE] = { handle_write },
					    [XS_MKDIR] = { handle_mkdir },
					    [XS_RM] = { handle_rm },
					    [XS_SET_PERMS] = { handle_set_perms },
					    [XS_WATCH_EVENT] = { NULL },
					    [XS_ERROR] = { NULL },
					    [XS_IS_DOMAIN_INTRODUCED] = { NULL },
					    [XS_RESUME] = { NULL },
					    [XS_SET_TARGET] = { NULL },
					    [XS_RESET_WATCHES] = { handle_reset_watches },
					    [XS_DIRECTORY_PART] = { NULL } };

struct watch_entry *key_to_watcher(char *key, bool complete, char *token)
{
	struct watch_entry *iter;
	size_t keyl = strlen(key);

	SYS_DLIST_FOR_EACH_CONTAINER (&watch_entry_list, iter, node) {
		if ((!complete || strlen(key) == strlen(iter->key)) &&
		    memcmp(iter->key, key, keyl) == 0 &&
		    (token == NULL || strlen(token) == 0 ||
		     0 == memcmp(iter->token, token, strlen(iter->token)))) {
			return iter;
		}
	}

	return NULL;
}

struct xs_entry *key_to_entry(char *key)
{
	static const char rootdir[] = "/";

	char *tok, *tok_state;
	struct xs_entry *next, *iter = NULL;
	sys_dlist_t *inspected_list = &root_xenstore.child_list;
	size_t keyl = strlen(key);

	if (strncmp(rootdir, key, keyl) == 0) {
		return &root_xenstore;
	}

	for (tok = strtok_r(key, "/", &tok_state); tok != NULL; tok = strtok_r(NULL, "/", &tok_state)) {
		SYS_DLIST_FOR_EACH_CONTAINER_SAFE (inspected_list, iter, next, node) {
			if (strcmp(iter->key, tok) == 0) {
				break;
			}
		}

		if (iter == NULL) {
			break;
		}

		inspected_list = &iter->child_list;
	}

	return iter;
}

static bool check_indexes(XENSTORE_RING_IDX cons, XENSTORE_RING_IDX prod)
{
	return ((prod - cons) > XENSTORE_RING_SIZE);
}

static size_t get_input_offset(XENSTORE_RING_IDX cons, XENSTORE_RING_IDX prod, size_t *len)
{
	size_t delta = prod - cons;
	*len = XENSTORE_RING_SIZE - MASK_XENSTORE_IDX(cons);

	if (delta < *len) {
		*len = delta;
	}

	return MASK_XENSTORE_IDX(cons);
}

static size_t get_output_offset(XENSTORE_RING_IDX cons, XENSTORE_RING_IDX prod, size_t *len)
{
	size_t delta = XENSTORE_RING_SIZE - cons + prod;
	*len = XENSTORE_RING_SIZE - MASK_XENSTORE_IDX(prod);

	if (delta < *len) {
		*len = delta;
	}

	return MASK_XENSTORE_IDX(prod);
}

void write_xb(struct xenstore_domain_interface *intf, uint8_t *data, uint32_t len)
{
	size_t blen = 0;
	size_t offset = 0;

	do {
		size_t tail = get_output_offset(intf->rsp_cons, intf->rsp_prod, &blen);

		if (blen == 0) {
			continue;
		}

		size_t effect = blen > len ? len : blen;
		memcpy(intf->rsp + tail, data + offset, effect);
		offset += effect;
		len -= effect;
		intf->rsp_prod += effect;
	} while (len > 0);
}

size_t read_xb(struct xen_domain *domain, uint8_t *data, uint32_t len)
{
	size_t blen = 0;
	size_t offset = 0;
	struct xenstore_domain_interface *intf = domain->domint;

	do {
		size_t prod = intf->req_prod;
		size_t ring_offset = get_input_offset(intf->req_cons, prod, &blen);

		if (blen == 0) {
			notify_evtchn(domain->local_xenstore_evtchn);
			return 0;
		}

		size_t effect = (blen > len) ? len : blen;
		memcpy(data + offset, intf->req + ring_offset, effect);
		offset += effect;
		len -= effect;
		intf->req_cons += effect;
	} while (len > 0);

	return offset;
}

void send_reply_sz(struct xen_domain *domain, uint32_t id, uint32_t msg_type, const char *payload,
		   int sz)
{
	struct xenstore_domain_interface *intf = domain->domint;
	struct xsd_sockmsg h = { .req_id = id, .type = msg_type, .len = sz };

	if (check_indexes(intf->rsp_cons, intf->rsp_prod)) {
		intf->rsp_cons = 0;
		intf->rsp_prod = 0;
	}

	write_xb(intf, (uint8_t *)&h, sizeof(struct xsd_sockmsg));
	notify_evtchn(domain->local_xenstore_evtchn);
	write_xb(intf, (uint8_t *)payload, sz);
	notify_evtchn(domain->local_xenstore_evtchn);
}

void send_reply(struct xen_domain *domain, uint32_t id, uint32_t msg_type, const char *payload)
{
	send_reply_sz(domain, id, msg_type, payload, strlen(payload) + 1);
}

void send_reply_read(struct xen_domain *domain, uint32_t id, uint32_t msg_type, char *payload)
{
	send_reply_sz(domain, id, msg_type, payload, strlen(payload));
}

void handle_directory(struct xen_domain *domain, uint32_t id, char *payload, uint32_t len)
{
	size_t data_offset = strlen(payload) + 1;
	const char localpath[] = "/";
	char path[STRING_LENGTH_MAX];

	if (memcmp(payload, localpath, strlen(localpath)) == 0) {
		memcpy(path, payload, data_offset);
	} else {
		snprintf(path, STRING_LENGTH_MAX, "/local/domain/%d/%s", domain->domid, payload);
	}

	char dirlist[256] = { 0 };
	size_t reply_sz = 0;

	k_mutex_lock(&xsel_mutex, K_FOREVER);
	struct xs_entry *entry = key_to_entry(path);

	if (entry) {
		struct xs_entry *iter;

		SYS_DLIST_FOR_EACH_CONTAINER (&entry->child_list, iter, node) {
			size_t keyl = strlen(iter->key) + 1;
			memcpy(dirlist + reply_sz, iter->key, keyl);
			reply_sz += keyl;
		}
	}

	k_mutex_unlock(&xsel_mutex);
	send_reply_sz(domain, id, XS_DIRECTORY, dirlist, reply_sz);
}

void send_errno(struct xen_domain *domain, uint32_t id, int err)
{
	unsigned int i;
	printk("Sending error=%d\n", err);

	for (i = 0; err != xsd_errors[i].errnum; i++) {
		if (i == ARRAY_SIZE(xsd_errors) - 1) {
			printk("xenstored: error %i untranslatable", err);
			i = 0; /* EINVAL */
			break;
		}
	}

	send_reply(domain, id, XS_ERROR, xsd_errors[i].errstring);
}

int fire_watcher(struct xen_domain *domain, uint32_t id, char *key)
{
	struct watch_entry *iter, *next;
	size_t kplen = strlen(key);
	char local[STRING_LENGTH_MAX];
	snprintf(local, STRING_LENGTH_MAX, "/local/domain/%d", domain->domid);
	size_t loclen = strlen(local);

	SYS_DLIST_FOR_EACH_CONTAINER_SAFE (&watch_entry_list, iter, next, node) {
		size_t klen = strlen(iter->key);
		if (memcmp(iter->key, key, klen) == 0) {
			size_t ioffset = 1;
			size_t ooffset = 0;
			if (iter->is_relative)
				klen = loclen;
			else {
				klen = 0;
				ioffset = 0;
				ooffset = 1;
			}

			size_t tlen = strlen(iter->token);
			size_t plen = tlen + kplen - klen + 1 + ooffset;
			char *pload = k_malloc(plen);

			memset(pload, 0, plen);
			memcpy(pload, key + klen + ioffset, kplen - klen);
			memcpy(pload + kplen - klen + ooffset, iter->token, tlen);

			send_reply_sz(domain, id, XS_WATCH_EVENT, pload, plen);

			k_free(pload);
		}
	}

	return 1;
}

void xss_do_write(char *const_path, char *data)
{
	struct xs_entry *iter = NULL;
	char *path;
	char *tok, *tok_state;
	size_t vall = strlen(data) + 1;
	size_t namelen;

	path = k_malloc(strlen(const_path) + 1);
	strcpy(path, const_path);

	k_mutex_lock(&xsel_mutex, K_FOREVER);
	sys_dlist_t *inspected_list = &root_xenstore.child_list;

	for (tok = strtok_r(path, "/", &tok_state); tok != NULL; tok = strtok_r(NULL, "/", &tok_state)) {
		SYS_DLIST_FOR_EACH_CONTAINER (inspected_list, iter, node) {
			if (strcmp(iter->key, tok) == 0) {
				break;
			}
		}

		if (iter == NULL) {
			iter = k_malloc(sizeof(*iter));

			namelen = strlen(tok);
			iter->key = k_malloc(namelen + 1);
			memcpy(iter->key, tok, namelen);
			iter->key[namelen] = 0;
			iter->value = NULL;

			sys_dlist_init(&iter->child_list);
			sys_dnode_init(&iter->node);
			sys_dlist_append(inspected_list, &iter->node);
		}

		inspected_list = &iter->child_list;
	}

	if (iter && vall > 0) {
		if (iter->value != NULL) {
			k_free(iter->value);
		}

		iter->value = k_malloc(vall);
		memcpy(iter->value, data, vall);
	}

	k_mutex_unlock(&xsel_mutex);
}

//TODO: header, moveto dom0.c
void notify_sibling_domains(uint32_t *sdom_list, size_t len)
{
	struct xen_domain *iter;

	for (size_t sdi=0;sdom_list[sdi];++sdi)
	{
		iter = domid_to_domain(sdom_list[sdi]);

		if (iter)
		{
			xs_evtchn_cb((void*)iter);
		}
	}
}

void _handle_write(struct xen_domain *domain, uint32_t id, uint32_t msg_type, char *payload,
		   uint32_t len)
{
	uint32_t data_offset = strlen(payload) + 1;
	char *data = payload + data_offset;

	if (len < data_offset) {
		printk("SIZES MISMATCH\n");
		send_errno(domain, id, EINVAL);
		return;
	}

	const char localpath[] = "/";
	char path[STRING_LENGTH_MAX];

	if (memcmp(payload, localpath, strlen(localpath)) == 0) {
		memcpy(path, payload, data_offset);
	} else {
		snprintf(path, STRING_LENGTH_MAX, "/local/domain/%d/%s", domain->domid, payload);
	}

	data[len - data_offset] = 0;
	xss_do_write(path, data);

	send_reply(domain, id, msg_type, "OK");

	struct watch_entry *iter;

	uint32_t sibling_domains[DOM_MAX] = {0};
	k_mutex_lock(&wel_mutex, K_FOREVER);
	SYS_DLIST_FOR_EACH_CONTAINER (&watch_entry_list, iter, node) {
		uint32_t iklen = strlen(iter->key);
		if (memcmp(iter->key, path, iklen) == 0) {
			struct pending_watch_event_entry *entry;
			entry = k_malloc(sizeof(*entry));
			size_t keyl = strlen(path) + 1;
			entry->key = k_malloc(keyl);
			memcpy(entry->key, path, keyl);
			entry->key[keyl - 1] = 0;
			entry->domid = iter->domid;

			if (iter->domid != domain->domid)
			{
				for (size_t sdi=0;sdi<DOM_MAX;++sdi)
				{
					if (sibling_domains[sdi] == 0 || sibling_domains[sdi] == iter->domid)
					{
						sibling_domains[sdi] = iter->domid;
						break;
					}
				}
			}

			k_mutex_lock(&pfl_mutex, K_FOREVER);
			sys_dnode_init(&entry->node);
			sys_dlist_append(&pending_watch_event_list, &entry->node);
			k_mutex_unlock(&pfl_mutex);
		}
	}

	k_mutex_unlock(&wel_mutex);

	notify_sibling_domains(sibling_domains, DOM_MAX);
}

void handle_write(struct xen_domain *domain, uint32_t id, char *payload, uint32_t len)
{
	_handle_write(domain, id, XS_WRITE, payload, len);
}

void handle_mkdir(struct xen_domain *domain, uint32_t id, char *payload, uint32_t len)
{
	_handle_write(domain, id, XS_MKDIR, payload, len);
}

void process_pending_watch_events(struct xen_domain *domain, uint32_t id)
{
	struct pending_watch_event_entry *iter, *next;
	k_mutex_lock(&pfl_mutex, K_FOREVER);

	SYS_DLIST_FOR_EACH_CONTAINER_SAFE (&pending_watch_event_list, iter, next, node) {
		if (domain->domid == iter->domid && domain->running_transaction == 0 && fire_watcher(domain, id, iter->key)) {
			if (domain->pending_stop_transaction == true && domain->stop_transaction_id == 0)
			{
				continue;
			}
			k_free(iter->key);
			sys_dlist_remove(&iter->node);
			k_free(iter);
		}
	}

	k_mutex_unlock(&pfl_mutex);
}

void handle_control(struct xen_domain *domain, uint32_t id, char *payload, uint32_t len)
{
	send_reply(domain, id, XS_CONTROL, "OK");
}

void handle_get_perms(struct xen_domain *domain, uint32_t id, char *payload, uint32_t len)
{
	send_errno(domain, id, ENOSYS);
}

void handle_set_perms(struct xen_domain *domain, uint32_t id, char *payload, uint32_t len)
{
	send_reply(domain, id, XS_SET_PERMS, "OK");
}

void remove_watch_entry(struct watch_entry *entry)
{
	k_free(entry->key);
	k_free(entry->token);
	sys_dlist_remove(&entry->node);
	k_free(entry);
}

void handle_reset_watches(struct xen_domain *domain, uint32_t id, char *payload, uint32_t len)
{
	struct watch_entry *iter, *next;

	k_mutex_lock(&wel_mutex, K_FOREVER);
	SYS_DLIST_FOR_EACH_CONTAINER_SAFE (&watch_entry_list, iter, next, node) {
		remove_watch_entry(iter);
	}
	k_mutex_unlock(&wel_mutex);

	send_reply(domain, id, XS_RESET_WATCHES, "OK");
}

void handle_read(struct xen_domain *domain, uint32_t id, char *payload, uint32_t len)
{
	const char localpath[] = "/";
	char path[STRING_LENGTH_MAX];

	if (memcmp(payload, localpath, strlen(localpath)) == 0) {
		memcpy(path, payload, strlen(payload) + 1);
	} else {
		snprintf(path, STRING_LENGTH_MAX, "/local/domain/%d/%s", domain->domid, payload);
	}

	struct xenstore_domain_interface *intf = domain->domint;
	struct xs_entry *entry = key_to_entry(path);

	if (entry) {
		send_reply_read(domain, id, XS_READ, entry->value ? entry->value : "");
		return;
	}

	send_reply(domain, id, XS_ERROR, "ENOENT");
}

void remove_recurse(sys_dlist_t *chlds)
{
	struct xs_entry *entry, *next;
	SYS_DLIST_FOR_EACH_CONTAINER_SAFE (chlds, entry, next, node) {
		if (entry->key) {
			k_free(entry->key);
			entry->key = NULL;
		}

		if (entry->value) {
			k_free(entry->value);
			entry->value = NULL;
		}

		remove_recurse(&entry->child_list);

		sys_dlist_remove(&entry->node);
		k_free(entry);
	}
}

void handle_rm(struct xen_domain *domain, uint32_t id, char *payload, uint32_t len)
{
	struct xs_entry *entry = key_to_entry(payload);

	if (entry) {
		if (entry->key) {
			k_free(entry->key);
			entry->key = NULL;
		}

		if (entry->value) {
			k_free(entry->value);
			entry->value = NULL;
		}

		k_mutex_lock(&xsel_mutex, K_FOREVER);
		sys_dlist_remove(&entry->node);
		sys_dlist_t chlds = entry->child_list;
		k_free(entry);
		k_mutex_unlock(&xsel_mutex);

		remove_recurse(&chlds);
	}

	send_reply_read(domain, id, XS_RM, "");
}

void handle_watch(struct xen_domain *domain, uint32_t id, char *payload, uint32_t len)
{
	const char localpath[] = "/";
	char path[STRING_LENGTH_MAX];
	char token[STRING_LENGTH_MAX];
	size_t plen = 0;
	bool is_relative = memcmp(payload, localpath, strlen(localpath)) != 0;
	for (; plen < len && payload[plen] != '\0'; ++plen)
		;
	plen += 1;

	if (is_relative) {
		snprintf(path, STRING_LENGTH_MAX, "/local/domain/%d/%s", domain->domid, payload);
	} else {
		memcpy(path, payload, plen);
	}

	memcpy(token, payload + plen, len - plen);

	struct watch_entry *entry = key_to_watcher(path, true, token);
	size_t lpath = strlen(path) + 1;

	if (!entry) {
		entry = k_malloc(sizeof(*entry));
		entry->key = k_malloc(lpath);
		memcpy(entry->key, path, lpath);
		entry->token = k_malloc(len - plen);
		memcpy(entry->token, token, len - plen);
		entry->domid = domain->domid;
		k_mutex_lock(&wel_mutex, K_FOREVER);
		sys_dnode_init(&entry->node);
		sys_dlist_append(&watch_entry_list, &entry->node);
		k_mutex_unlock(&wel_mutex);
	}

	entry->is_relative = is_relative;

	send_reply(domain, id, XS_WATCH, "OK");

	k_mutex_lock(&xsel_mutex, K_FOREVER);

	if (key_to_entry(path)) {
		struct pending_watch_event_entry *entry;
		entry = k_malloc(sizeof(*entry));
		entry->key = k_malloc(lpath);
		memcpy(entry->key, path, lpath);
		entry->domid = domain->domid;
		k_mutex_lock(&pfl_mutex, K_FOREVER);
		sys_dnode_init(&entry->node);
		sys_dlist_append(&pending_watch_event_list, &entry->node);
		k_mutex_unlock(&pfl_mutex);
	}

	k_mutex_unlock(&xsel_mutex);
}

void handle_unwatch(struct xen_domain *domain, uint32_t id, char *payload, uint32_t len)
{
	const char localpath[] = "/";
	char path[STRING_LENGTH_MAX] = { 0 };
	char token[STRING_LENGTH_MAX] = { 0 };
	size_t plen = 0;
	for (; plen < len && payload[plen] != '\0'; ++plen)
		;
	plen += 1;

	if (memcmp(payload, localpath, strlen(localpath)) == 0) {
		memcpy(path, payload, plen);
	} else {
		snprintf(path, STRING_LENGTH_MAX, "/local/domain/%d/%s", domain->domid, payload);
	}

	memcpy(token, payload + plen, len - plen);
	struct watch_entry *entry = key_to_watcher(path, true, token);

	if (entry) {
		if (entry->domid == domain->domid) {
			k_mutex_lock(&wel_mutex, K_FOREVER);
			remove_watch_entry(entry);
			k_mutex_unlock(&wel_mutex);
		}
	}

	send_reply(domain, id, XS_UNWATCH, "");
}

void handle_transaction_start(struct xen_domain *domain, uint32_t id, char *payload, uint32_t len)
{
	char buf[8] = { 0 };

	if (domain->running_transaction)
	{
		printk("%d: transaction already started\n", domain->domid);
		send_errno(domain, id, EBUSY);
		return;
	}

	domain->running_transaction = ++domain->transaction;
	snprintf(buf, 8, "%d", domain->running_transaction);
	send_reply(domain, id, XS_TRANSACTION_START, buf);
}

void handle_transaction_stop(struct xen_domain *domain, uint32_t id, char *payload, uint32_t len)
{
	// TODO check contents, transaction completion, etc
	domain->stop_transaction_id = id;
	domain->pending_stop_transaction = true;
	domain->running_transaction = 0;
}

void handle_get_domain_path(struct xen_domain *domain, uint32_t id, char *payload, uint32_t len)
{
	char path[32] = { 0 };
	char domid[8] = { 0 };
	memcpy(domid, payload, len);
	snprintf(path, 32, "/local/domain/%s", domid);
	send_reply(domain, id, XS_GET_DOMAIN_PATH, path);
}

void xs_evtchn_cb(void *priv)
{
	struct xen_domain *domain = (struct xen_domain *)priv;
	k_sem_give(&domain->xb_sem);
}

int start_domain_stored(struct xen_domain *domain)
{
	size_t slot = 0;
	int rc = 0;

	k_sem_init(&domain->xb_sem, 0, 1);
	domain->local_xenstore_evtchn = bind_interdomain_event_channel(domain->domid,
								       domain->xenstore_evtchn,
								       xs_evtchn_cb,
								       (void *)domain);

	rc = hvm_set_parameter(HVM_PARAM_STORE_EVTCHN, domain->domid, domain->xenstore_evtchn);
	if (rc) {
		printk("Failed to set domain xenbus evtchn param, rc= %d\n", rc);
		return rc;
	}

	domain->xenstore_thrd_stop = false;

	for (; slot < DOM_MAX && stack_slots[slot] != 0; ++slot)
		;

	if (slot >= DOM_MAX) {
		printk("Unable to find memory for xenbus stack (%ld >= MAX:%d)\n", slot, DOM_MAX);
		return 1;
	}

	stack_slots[slot] = domain->domid;
	domain->stack_slot = slot;
	domain->xenstore_tid =
		k_thread_create(&domain->xenstore_thrd, xenstore_thrd_stack + XENSTORE_STACK_SIZE_PER_DOM * slot,
				K_KERNEL_STACK_SIZEOF(xenstore_thrd_stack) / DOM_MAX, xenstore_evt_thrd,
				domain, NULL, NULL, 7, 0, K_NO_WAIT);

	return 0;
}

int stop_domain_stored(struct xen_domain *domain)
{
	int rc = 0;

	printk("Destroy domain=%p\n", domain);
	domain->xenstore_thrd_stop = true;
	k_sem_give(&domain->xb_sem);
	k_thread_join(&domain->xenstore_thrd, K_FOREVER);
	stack_slots[domain->stack_slot] = 0;
	unbind_event_channel(domain->local_xenstore_evtchn);
	rc = evtchn_close(domain->local_xenstore_evtchn);

	if (rc)
	{
		printk("Unable to close event channel %d, rc=%d\n", domain->local_xenstore_evtchn, rc);
	}

	return rc;
}

void xenstore_evt_thrd(void *p1, void *p2, void *p3)
{
	ARG_UNUSED(p2);
	ARG_UNUSED(p3);

	size_t sz;
	size_t delta;
	struct xsd_sockmsg *header;
	char input_buffer[XENSTORE_RING_SIZE];
	struct xen_domain *domain = p1;
	struct xenstore_domain_interface *intf = domain->domint;

	domain->transaction = 0;
	domain->running_transaction = 0;
	domain->stop_transaction_id = 0;
	domain->pending_stop_transaction = false;

	while (!domain->xenstore_thrd_stop) {
		process_pending_watch_events(domain, domain->running_transaction);

		if (domain->pending_stop_transaction) {
			send_reply(domain, domain->stop_transaction_id, XS_TRANSACTION_END, "");
			domain->stop_transaction_id = 0;
			domain->pending_stop_transaction = false;
		}

		if (intf->req_prod <= intf->req_cons)
		{
			k_sem_take(&domain->xb_sem, K_FOREVER);
		}

		header = (struct xsd_sockmsg*)input_buffer;
		sz = 0;

		do {
			delta = read_xb(domain, (uint8_t *)input_buffer + sz, sizeof(struct xsd_sockmsg));

			if (delta == 0)
			{
				/* Missing header data, nothing to read. Perhaps pending watch event from
				 * different domain. */
				break;
			}

			sz += delta;
		} while (sz < sizeof(struct xsd_sockmsg));

		if (sz == 0)
		{
			/* Skip message body processing, as no header received. */
			continue;
		}

		sz = 0;

		do
		{
			delta = read_xb(domain, (uint8_t *)input_buffer + sizeof(struct xsd_sockmsg) + sz, header->len);
			sz += delta;
		} while (sz < header->len);

		if (message_handle_list[header->type].h == NULL) {
			printk("Unsupported message type: %d\n", header->type);
			send_errno(domain, header->req_id, ENOSYS);
		} else {
			message_handle_list[header->type].h(domain, header->req_id,
							 (char *)(header + 1), header->len);
		}

		notify_evtchn(domain->local_xenstore_evtchn);
	}
}

void init_root(void)
{
	sys_dlist_init(&root_xenstore.child_list);
	sys_dnode_init(&root_xenstore.node);
}
```

## src/xen_cmds.c
```c
#include <zephyr/shell/shell.h>

extern int domu_console_start(const struct shell *shell, size_t argc, char **argv);
extern int domu_console_stop(const struct shell *shell, size_t argc, char **argv);
extern int domu_create(const struct shell *shell, size_t argc, char **argv);
extern int domu_destroy(const struct shell *shell, size_t argc, char **argv);
extern int domu_pause(const struct shell *shell, size_t argc, char **argv);
extern int domu_unpause(const struct shell *shell, size_t argc, char **argv);

SHELL_STATIC_SUBCMD_SET_CREATE(
	subcmd_xu,
	SHELL_CMD_ARG(create, NULL,
		      " Create Xen domain\n"
		      " Usage: create -d <domid>\n",
		      domu_create, 3, 0),
	SHELL_CMD_ARG(destroy, NULL,
		      " Destroy Xen domain\n"
		      " Usage: destroy -d <domid>\n",
		      domu_destroy, 3, 0),
	SHELL_CMD_ARG(console_start, NULL,
		      " Start console thread for Xen domain\n"
		      " Only single thread and only output is currently supported\n"
		      " Usage: console_start -d <domid>\n",
		      domu_console_start, 3, 0),
	SHELL_CMD_ARG(console_stop, NULL,
		      " Stop console thread for Xen domain\n"
		      " Usage: console_stop -d <domid>\n",
		      domu_console_stop, 3, 0),
	SHELL_CMD_ARG(pause, NULL,
		      " Pause Xen domain\n"
		      " Usage: pause -d <domid>\n",
		      domu_pause, 3, 0),
	SHELL_CMD_ARG(unpause, NULL,
		      " Unpause Xen domain\n"
		      " Usage: unpause -d <domid>\n",
		      domu_unpause, 3, 0),
	SHELL_SUBCMD_SET_END);

SHELL_CMD_ARG_REGISTER(xu, &subcmd_xu, "Xenutils commands", NULL, 2, 0);
```
